## linux/linux/linux/drivers/net/hnd/Config.in
```kconfig
#
# Broadcom Home Networking Division (HND) driver configuration
#
# $Copyright Open Broadcom Corporation$
#

mainmenu_option next_comment
   comment 'Broadcom HND network devices'
   dep_bool 'Broadcom HND network device support' CONFIG_HND $CONFIG_PCI
   if [ "$CONFIG_HND" != "n" ]; then
      dep_tristate '  InsideLine HPNA support' CONFIG_IL $CONFIG_HND
      if [ "$CONFIG_IL" != "n" ]; then
         bool '    BCM42xx support' CONFIG_IL_42XX
         bool '    BCM47xx support' CONFIG_IL_47XX
         int '    LARQ buffer allocation (0 = tiny, 2 = huge)' CONFIG_LARQ_BUF 0
      fi
      dep_tristate '  10/100/1000 Ethernet support' CONFIG_ET $CONFIG_HND 
      if [ "$CONFIG_ET" != "n" ]; then
         bool '    BCM47xx support' CONFIG_ET_47XX
      fi
      dep_tristate '    BCMCTF support' CONFIG_BCM_CTF $CONFIG_HND
      dep_bool '  Broadcom PLC network failover support' CONFIG_PLC $CONFIG_ET_47XX
      dep_tristate '  WL emulation using Gigabit ethernet' CONFIG_WL_EMULATOR $CONFIG_HND
      if [ "$CONFIG_WL_EMULATOR" != "n" ]; then
         comment '    BCM57xx support is ON'
         define_tristate CONFIG_BCM57XX $CONFIG_WL_EMULATOR
         comment '    Wireless feature variant is set to AP'
         define_tristate CONFIG_WL $CONFIG_WL_EMULATOR
         define_bool CONFIG_WL_USE_AP y
      else
         dep_tristate '  BCM57xx Gigabit Ethernet support' CONFIG_BCM57XX $CONFIG_HND
         dep_tristate '  BCM43xx 802.11 Wireless support' CONFIG_WL $CONFIG_HND
         if [ "$CONFIG_WL" != "n" ]; then
            bool '     Wireless Authentication Privacy Infrastructure (WAPI) support' CONFIG_WAPI
            if [ "$CONFIG_WAPI" != "n" ]; then
               define_bool CONFIG_MTD_BCMCONF_PARTS y
            fi
            choice '    Wireless feature variant' \
               "ap	CONFIG_WL_USE_AP \
                ap_sdstd	CONFIG_WL_USE_AP_SDSTD \
                sta	CONFIG_WL_USE_STA \
                apsta	CONFIG_WL_USE_APSTA \
                ap_onchip_g	CONFIG_WL_USE_AP_ONCHIP_G \
                sta_onchip_g	CONFIG_WL_USE_STA_ONCHIP_G \
                apsta_onchip_g	CONFIG_WL_USE_APSTA_ONCHIP_G"
	    bool '    USB/HSIC Wireless Access Point support'	CONFIG_WL_USBAP
#if defined(WLSRC) || defined(PREBUILD)
            string '    Config file for basic AP variant' \
			CONFIG_WL_AP wlconfig_lx_router_ap
            string '    Config file for basic AP sdstd variant' \
			CONFIG_WL_AP_SDSTD wlconfig_lx_router_ap_sdstd
            string '    Config file for basic STA variant' \
			CONFIG_WL_STA wlconfig_lx_router_sta
            string '    Config file for basic APSTA variant' \
			CONFIG_WL_APSTA wlconfig_lx_router_apsta
            string '    Config file for high part of the split driver' \
			CONFIG_WL_HIGH wlconfig_lx_router_high
            string '    Config file for AP 1chipG variant' \
			CONFIG_WL_AP_ONCHIP_G wlconfig_lx_router_ap_1chipG
            string '    Config file for STA 1chipG variant' \
			CONFIG_WL_STA_ONCHIP_G wlconfig_lx_router_sta_1chipG
            string '    Config file for APSTA 1chipG variant' \
		 	CONFIG_WL_APSTA_ONCHIP_G wlconfig_lx_router_apsta_1chipG
#endif
         fi
      fi
   fi
endmenu
```

## linux/linux/linux/net/ipv4/Config.in
```kconfig
#
# IP configuration
#
bool '  Passthrough all netfilter chain' CONFIG_PASSTHROUGH_ALL_CHAIN
bool '  IP Conflict Detection' CONFIG_IPCONFLICT_DETECT
tristate '  Twin IP' CONFIG_DRIVERLEVEL_REAL_IPCLONE
tristate '  Multicast Device Level Forwarding' CONFIG_MULTICAST_FORWARD
tristate '  LG Dacom VOID QOS' CONFIG_LGDACOM_VOIP_QOS
tristate '  Smart QoS Monitor' CONFIG_SMART_QOS_MONITOR
bool '  IP: multicasting' CONFIG_IP_MULTICAST
bool '  IP: advanced router' CONFIG_IP_ADVANCED_ROUTER
if [ "$CONFIG_IP_ADVANCED_ROUTER" = "y" ]; then
   bool '    IP: policy routing' CONFIG_IP_MULTIPLE_TABLES
   if [ "$CONFIG_IP_MULTIPLE_TABLES" = "y" ]; then
      if [ "$CONFIG_NETFILTER" = "y" ]; then
         bool '      IP: use netfilter MARK value as routing key' CONFIG_IP_ROUTE_FWMARK
      fi
      bool '      IP: fast network address translation' CONFIG_IP_ROUTE_NAT
   fi
   bool '    IP: equal cost multipath' CONFIG_IP_ROUTE_MULTIPATH
   bool '    IP: use TOS value as routing key' CONFIG_IP_ROUTE_TOS
   bool '    IP: verbose route monitoring' CONFIG_IP_ROUTE_VERBOSE
   bool '    IP: large routing tables' CONFIG_IP_ROUTE_LARGE_TABLES
fi
bool '  IP: kernel level autoconfiguration' CONFIG_IP_PNP
if [ "$CONFIG_IP_ROUTING_CACHE_LIMIT" == "y" ]; then
    int ' ROUTING CACHE SIZE ' CONFIG_ROUTING_CACHE_SIZE 1024
    int ' DEFAULT GC INTERVAL ' CONFIG_ROUTING_GC_INTERVAL 1
    int ' DEFAULT GC TIMEOUT '  CONFIG_ROUTING_GC_TIMEOUT 1
fi
if [ "$CONFIG_IP_PNP" = "y" ]; then
   bool '    IP: DHCP support' CONFIG_IP_PNP_DHCP
   bool '    IP: BOOTP support' CONFIG_IP_PNP_BOOTP
   bool '    IP: RARP support' CONFIG_IP_PNP_RARP
# not yet ready..
#   bool '    IP: ARP support' CONFIG_IP_PNP_ARP		
fi
tristate '  IP: tunneling' CONFIG_NET_IPIP
tristate '  IP: GRE tunnels over IP' CONFIG_NET_IPGRE
if [ "$CONFIG_IP_MULTICAST" = "y" ]; then
   if [ "$CONFIG_NET_IPGRE" != "n" ]; then
      bool '    IP: broadcast GRE over IP' CONFIG_NET_IPGRE_BROADCAST
   fi
   bool '  IP: multicast routing' CONFIG_IP_MROUTE
   bool '  Skip Netfilter HOOK for multicast packets '  CONFIG_SKIP_NETFILTER_HOOK_FOR_MULTICAST
   if [ "$CONFIG_IP_MROUTE" = "y" ]; then
      bool '    IP: PIM-SM version 1 support' CONFIG_IP_PIMSM_V1
      bool '    IP: PIM-SM version 2 support' CONFIG_IP_PIMSM_V2
   fi
fi
if [ "$CONFIG_EXPERIMENTAL" = "y" ]; then
   bool '  IP: ARP daemon support (EXPERIMENTAL)' CONFIG_ARPD
fi
bool '  IP: TCP Explicit Congestion Notification support' CONFIG_INET_ECN
bool '  IP: TCP syncookie support (disabled per default)' CONFIG_SYN_COOKIES
if [ "$CONFIG_NETFILTER" != "n" ]; then
   bool '  FORWARD SPEED UP PATCH ' CONFIG_FORWARD_SPEED_UP_PATCH
   source net/ipv4/netfilter/Config.in
fi
```
